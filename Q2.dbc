VERSION ""

NS_ :

BS_:
BU_:
BO_ 1056 420: 1 Vector__XXX
   SG_ Request_Byte : 7|8@0+ (1,0) [0|1] "" Vector__XXX

BO_ 1680 690: 2 Vector__XXX
   SG_ analog_reading : 7|16@0+ (1,0) [0|1] "" Vector__XXX

BA_DEF_ BO_ "GenMsgBackgroundColor" STRING ;
BA_DEF_ BO_ "GenMsgForegroundColor" STRING ;
BA_DEF_ BO_ "filterlabeling" INT 0 0;
BA_DEF_ BO_ "filterlabeling" INT 0 0;
BA_ "GenMsgBackgroundColor" BO_ 1056 "#3cfff2";
BA_ "GenMsgBackgroundColor" BO_ 1680 "#fff677";
BA_DEF_DEF_ "GenMsgBackgroundColor" "#ffffff";
BA_DEF_DEF_ "GenMsgForegroundColor" "#000000";
BA_DEF_DEF_ "filterlabeling" 1;
BA_DEF_DEF_ "filterlabeling" true;
VAL_ 1056 Request_Byte 105 "request_message" 105 "No Description";
VAL_ 1680 analog_reading 0 "0";
